## main/Kconfig
```kconfig
menu "Project Configuration"

    config WIFI_SSID
        string "WiFi SSID"
        default "myssid"
        help
            WiFi SSID (network name) to connect to.

    config WIFI_PASSWORD
        string "WiFi Password"
        default "mypassword"
        help
            WiFi password (WPA or WPA2) of network.
endmenu
```

## main/Kconfig.projbuild
```kconfig
menu "Project Configuration"

    config WIFI_SSID
        string "WiFi SSID"
        default "myssid"
        help
            WiFi SSID (network name) to connect to.

    config WIFI_PASSWORD
        string "WiFi Password"
        default "mypassword"
        help
            WiFi password (WPA or WPA2) of network.

    config LWIP_LOCAL_HOSTNAME
        string "Hostname"
        default "I2S Bridge"
        help
            Hostname for this device.

    config ENABLE_AUTOMATIC_LIGHT_SLEEP
        bool "Use automatic light sleep when possible."
        default y
        depends on PM_ENABLE
        depends on FREERTOS_USE_TICKLESS_IDLE
        help
            Enable automatic light sleep when idle.

endmenu
```

## sdkconfig.defaults
```kconfig
# Halt on panic for easier debug
CONFIG_ESP32_PANIC_PRINT_HALT=y
# Increase FreeRTOS tick rate
CONFIG_FREERTOS_HZ=1000
# Fastest CPU possible
CONFIG_ESP32_DEFAULT_CPU_FREQ_240=y
CONFIG_ESP32_DEFAULT_CPU_FREQ_MHZ=240
CONFIG_ESPTOOLPY_FLASHMODE_QIO=y
CONFIG_ESPTOOLPY_FLASHMODE="qio"
CONFIG_ESPTOOLPY_FLASHFREQ_80M=y
CONFIG_ESPTOOLPY_FLASHFREQ="80m"
# Increase TX throughput
CONFIG_LWIP_IRAM_OPTIMIZATION=y
CONFIG_ESP32_WIFI_DYNAMIC_TX_BUFFER_NUM=64
CONFIG_ESP32_WIFI_TX_BA_WIN=32
CONFIG_LWIP_TCP_SND_BUF_DEFAULT=65534
# This is an RX option, but the default doesn't match espressif's recommendation of 2*min(CONFIG_ESP32_WIFI_STATIC_RX_BUFFER_NUM, CONFIG_ESP32_WIFI_DYNAMIC_RX_BUFFER_NUM)
CONFIG_ESP32_WIFI_RX_BA_WIN=20
```
